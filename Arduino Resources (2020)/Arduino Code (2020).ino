//  created 2020
//  by WU,SHIHAO
//  modified 24 May 2020
//  by WU,SHIHAO
// *Note*: the code was been successfully complied in Arduino's official IDE but cannot test the overall compatibility with the actual 
//  device. Only some modules are been successfully tested which are LED, OLED screen and button)


#include <SparkFun_SCD30_Arduino_Library.h>
#include <ArduinoBLE.h>
#include <Wire.h>
#include <Adafruit_GFX.h>
#include <Adafruit_SSD1306.h>

// EEPROM I2C Address
#define EEPROM_I2C_ADDRESS 0x50
// defind other pins
#define acetonePin A0
#define BUTTON 10
#define TempSensor A3
#define SCREEN_WIDTH 128 // OLED display width, in pixels
#define SCREEN_HEIGHT 32 // OLED display height, in pixels
#define NUMFLAKES 10
#define XPOS 0
#define YPOS 1
#define DELTAY 2
//#define led_pin 5

//define variables
unsigned long acetoneRead;
const unsigned long heaterTimeOut = 1*60*1000;
unsigned long lastMessage;
unsigned long starttime;
unsigned long endtime;
unsigned long breath_end;
const int buzzer = 2;
const float Rshunt = 1000.0; //ohms
String string;
uint16_t Acetonemaximum=0;
uint16_t Acetoneminimum=1023;
uint16_t temp_read = 0;//tmep_read is standing for temporary reading
uint16_t temp_current = 0;
int address1 = 0;
int maxaddress = 20;
const int RED_PIN = 5; //The external LED pin
bool heating = false;
void(* reset) (void) = 0;
int val = 0;
int old_val = 0;
int buttonState = 0; // 0 is off, 1 is on


//these variables are used for OLED display, can be adjusted easily
double count_T=0;
double count=1.21;
int16_t h;
int16_t i;
int16_t k;
int16_t j;
int16_t m;


// Here should be suppose SCD40 if the CO2 sensor is available
SCD30 airSensor;


UART mySerial(digitalPinToPinName(3), digitalPinToPinName(4), NC, NC);  // create a hardware serial port named mySerial with RX: pin 4 and TX: pin 3

// Crate AcetoneService and Store service which can be further used for transmitting data via Bluetooth 
BLEService AcetoneService("1101");
BLEUnsignedCharCharacteristic AcetoneLevelChar("2101", BLERead | BLENotify);

BLEService StoreService("2101");
BLEUnsignedCharCharacteristic StoreChar("3101", BLERead | BLENotify);


// Declaration for an SSD1306 display connected to I2C (SDA, SCL pins)
Adafruit_SSD1306 display(SCREEN_WIDTH, SCREEN_HEIGHT, &Wire, -1);

//OLED variables, the first one is the ANU LOGO show in the video demo
static const unsigned char PROGMEM ANU_LOGO[] = {
    0x00,0x00,0x00,0x00,0x00,0x00,0x00,0x00,0x00,0x00,0x00,0x00,0x00,0x00,0x00,0x00,
    0x00,0x00,0x00,0x00,0x00,0x00,0x00,0x00,0x00,0x00,0x00,0x00,0x00,0x00,0x00,0x00,
    0x00,0x00,0x00,0x00,0x00,0x00,0x00,0x00,0x00,0x00,0x00,0x00,0x00,0x00,0x00,0x00,
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    0x00,0x00,0x00,0x00,0x00,0x00,0x00,0x00,0x00,0x00,0x00,0x00,0x00,0x00,0x00,0x00
};
// the second variable is the device name
static const unsigned char PROGMEM DEVICE_LOGO[] = {
    0x00,0x00,0x00,0x00,0x00,0x00,0x00,0x00,0x00,0x00,0x00,0x00,0x00,0x00,0x00,0x00,
    0x00,0x00,0x00,0x00,0x00,0x00,0x00,0x00,0x00,0x00,0x00,0x00,0x00,0x00,0x00,0x00,
    0x00,0x01,0xFE,0x00,0x00,0x00,0x0E,0x00,0x79,0x80,0x0C,0x00,0x00,0x00,0x00,0x00,
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    0x00,0x00,0x00,0x00,0x00,0x00,0x00,0x00,0xE0,0x00,0x00,0x00,0x00,0x00,0x00,0x00

};

// these are the variables that used for animated icons
const unsigned char PROGMEM frame0 [] = {0x00, 0x00, 0x00, 0x00, 0x00, 0x00, 0x00, 0x00, 0x00, 0x00, 0x00, 0x00, 0x00,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 0x00, 0x00};

const unsigned char PROGMEM frame1 [] = {0x00, 0x00, 0x00, 0x00, 0x00, 0x00, 0x00, 0x00, 0x00, 0x00, 0x00, 0x00, 0x00,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 0x00, 0x00};

const unsigned char PROGMEM frame2 [] = {0x00, 0x00, 0x00, 0x00, 0x00, 0x00, 0x00, 0x00, 0x00, 0x00, 0x00, 0x00, 0x00,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 0x00, 0x00};

const unsigned char PROGMEM frame3 [] = {0x00, 0x00, 0x00, 0x00, 0x00, 0x00, 0x00, 0x00, 0x00, 0x00, 0x00, 0x00, 0x00,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 0x00, 0x00};

const unsigned char PROGMEM frame4 [] = {0x00, 0x00, 0x00, 0x00, 0x00, 0x00, 0x00, 0x00, 0x00, 0x00, 0x00, 0x00, 0x00,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 0x00, 0x00};

const unsigned char PROGMEM frame5 [] = {0x00, 0x00, 0x00, 0x00, 0x00, 0x00, 0x00, 0x00, 0x00, 0x00, 0x00, 0x00, 0x00,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 0x00, 0x00};

const unsigned char PROGMEM frame6 [] = {0x00, 0x00, 0x00, 0x00, 0x00, 0x00, 0x00, 0x00, 0x00, 0x00, 0x00, 0x00, 0x00,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 0x00, 0x00};

const unsigned char PROGMEM frame7 [] = {0x00, 0x00, 0x00, 0x00, 0x00, 0x00, 0x00, 0x00, 0x00, 0x00, 0x00, 0x00, 0x00,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 0x00, 0x00};

const unsigned char PROGMEM frame8 [] = {0x00, 0x00, 0x00, 0x00, 0x00, 0x00, 0x00, 0x00, 0x00, 0x00, 0x00, 0x00, 0x00,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 0x00, 0x00};

const unsigned char PROGMEM frame9 [] = {0x00, 0x00, 0x00, 0x00, 0x00, 0x00, 0x00, 0x00, 0x00, 0x00, 0x00, 0x00, 0x00,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 0x00, 0x00};

const unsigned char PROGMEM frame10 [] = {0x00, 0x00, 0x00, 0x00, 0x00, 0x00, 0x00, 0x00, 0x00, 0x00, 0x00, 0x00, 0x00,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 0x00, 0x00};

const unsigned char PROGMEM frame11 [] = {0x00, 0x00, 0x00, 0x00, 0x00, 0x00, 0x00, 0x00, 0x00, 0x00, 0x00, 0x00, 0x00,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 0x00, 0x00};

const unsigned char PROGMEM frame12 [] = {0x00, 0x00, 0x00, 0x00, 0x00, 0x00, 0x00, 0x00, 0x00, 0x00, 0x00, 0x00, 0x00,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 0x00, 0x00};

const unsigned char PROGMEM frame13 [] = {0x00, 0x00, 0x00, 0x00, 0x00, 0x00, 0x00, 0x00, 0x00, 0x00, 0x00, 0x00, 0x00,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 0x00, 0x00};

const unsigned char PROGMEM frame14 [] = {0x00, 0x00, 0x00, 0x00, 0x00, 0x00, 0x00, 0x00, 0x00, 0x00, 0x00, 0x00, 0x00,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 0x00, 0x00};

const unsigned char PROGMEM frame15 [] = {0x00, 0x00, 0x00, 0x00, 0x00, 0x00, 0x00, 0x00, 0x00, 0x00, 0x00, 0x00, 0x00,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 0x00, 0x00};

const unsigned char PROGMEM frame16 [] = {0x00, 0x00, 0x00, 0x00, 0x00, 0x00, 0x00, 0x00, 0x00, 0x00, 0x00, 0x00, 0x00,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 0x00, 0x00};

const unsigned char PROGMEM frame17 [] = {0x00, 0x00, 0x00, 0x00, 0x00, 0x00, 0x00, 0x00, 0x00, 0x00, 0x00, 0x00, 0x00,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 0x00, 0x00};

const unsigned char PROGMEM frame18 [] = {0x00, 0x00, 0x00, 0x00, 0x00, 0x00, 0x00, 0x00, 0x00, 0x00, 0x00, 0x00, 0x00,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 0x00, 0x00};

const unsigned char PROGMEM frame19 [] = {0x00, 0x00, 0x00, 0x00, 0x00, 0x00, 0x00, 0x00, 0x00, 0x00, 0x00, 0x00, 0x00,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 0x00, 0x00};

const unsigned char PROGMEM frame20 [] = {0x00, 0x00, 0x00, 0x00, 0x00, 0x00, 0x00, 0x00, 0x00, 0x00, 0x00, 0x00, 0x00,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 0x00, 0x00};

const unsigned char PROGMEM frame21 [] = {0x00, 0x00, 0x00, 0x00, 0x00, 0x00, 0x00, 0x00, 0x00, 0x00, 0x00, 0x00, 0x00,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 0x00, 0x00};

const unsigned char PROGMEM frame22 [] = {0x00, 0x00, 0x00, 0x00, 0x00, 0x00, 0x00, 0x00, 0x00, 0x00, 0x00, 0x00, 0x00,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 0x00, 0x00};

const unsigned char PROGMEM frame23 [] = {0x00, 0x00, 0x00, 0x00, 0x00, 0x00, 0x00, 0x00, 0x00, 0x00, 0x00, 0x00, 0x00,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 0x00, 0x00};

const unsigned char PROGMEM frame24 [] = {0x00, 0x00, 0x00, 0x00, 0x00, 0x00, 0x00, 0x00, 0x00, 0x00, 0x00, 0x00, 0x00,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 0x00, 0x00};

const unsigned char PROGMEM frame25 [] = {0x00, 0x00, 0x00, 0x00, 0x00, 0x00, 0x00, 0x00, 0x00, 0x00, 0x00, 0x00, 0x00,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 0x00, 0x00};

const unsigned char PROGMEM frame26 [] = {0x00, 0x00, 0x00, 0x00, 0x00, 0x00, 0x00, 0x00, 0x00, 0x00, 0x00, 0x00, 0x00,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 0x00, 0x00};

const unsigned char PROGMEM frame27 [] = {0x00, 0x00, 0x00, 0x00, 0x00, 0x00, 0x00, 0x00, 0x00, 0x00, 0x00, 0x00, 0x00,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 0x00, 0x00};

const unsigned char PROGMEM frame28 [] = {0x00, 0x00, 0x00, 0x00, 0x00, 0x1F, 0xF8, 0x00, 0x00, 0x7C, 0x1E, 0x00, 0x01,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 0x00, 0x00};

const unsigned char PROGMEM frame29 [] = {0x00, 0x00, 0x00, 0x00, 0x00, 0x1F, 0xF8, 0x00, 0x00, 0x7C, 0x1E, 0x00, 0x01,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 0x00, 0x00};


void setup() {
  // put your setup code here, to run once:
  Serial.begin(115200);
  mySerial.begin(115200);
  Wire.begin();
 // Initialise buzze,button,CO2 sensor and LED light
  pinMode(buzzer, OUTPUT);
  pinMode(BUTTON,INPUT);
  pinMode(RED_PIN, OUTPUT);
  digitalWrite(RED_PIN, LOW);
  airSensor.begin();
  // A beep sound that indicate user system is been initalised 
  tone(buzzer, 1000);
  delay(500);
    
  if (!BLE.begin()) 
  {
  Serial.println("starting BLE failed!");
  while (1);
  }
  // if we have an external EEPROM, it will read the value from EEPROM
  for (int address = 0; address <= maxaddress; address++){
    // Read value from EEPROM
    temp_read = readEEPROM(address, EEPROM_I2C_ADDRESS);
  }

  // Initialise Bluetooth services
  BLE.setLocalName("Acetonedetector");
  BLE.setAdvertisedService(AcetoneService);
  AcetoneService.addCharacteristic(AcetoneLevelChar);
  BLE.addService(AcetoneService);
  
  BLE.setLocalName("StoreReadings");
  BLE.setAdvertisedService(StoreService);
  StoreService.addCharacteristic(StoreChar);
  BLE.addService(StoreService);


  
  // begin advertise the service
  BLE.advertise();
  Serial.println("Bluetooth device active, waiting for connections...");
}

void loop() {
  // put your main code here, to run repeatedly:

// get the state of whether button is been pressed or not
buttonState = digitalRead(BUTTON);

if (buttonState==HIGH){
  // Start to auto heating, read the value from contacted temp sensor in real time
  float CurrentTemp = analogRead(TempSensor);
    starttime = millis();
    endtime = starttime;
  while ((endtime - starttime) <=1000){ //every 1 second to check the acetone sensor temp
    if (CurrentTemp < 340) { //determine the temperature of acetone sensor, if it below than 340, keep heating
      heating = true;
      display.clearDisplay();
      // Display the real time temp reading on OLED screen
      String TString =  String(CurrentTemp,0);
      Devicetext("Heating!", 20, 0, 2, false);
      Devicetext("Temp:   ", 30, 25, 1, false);
      Devicetext(TString, 65, 25, 1, false);
      Devicetext("C", 90, 25, 1, false);
      display.display();
      // Flashing the RED LED light
      digitalWrite(RED_PIN,HIGH); 
      delay(250);
      digitalWrite(RED_PIN,LOW);
      delay(250);
      digitalWrite(RED_PIN,HIGH); 
      delay(250);
      digitalWrite(RED_PIN,LOW);
      delay(250);    
    } else if (CurrentTemp >= 355) { //If temp >355,  stop heating and LED OFF
      heating = false;
      digitalWrite(RED_PIN, LOW);
    } 
  } 
    // Update the timestamp
    lastMessage = millis();
    // Determining if overall heating time is over 1 min and still heating, force it to stop the heating process
  if(heating && (millis()-lastMessage>heaterTimeOut)){
    heating = false;
    digitalWrite(RED_PIN, LOW);
    // notify user by signaling the screen and buzzer
    ready_sig(3);
    tone(buzzer, 1000);
  }

    if (airSensor.dataAvailable()){
    // if the CO2 sensor know user start to breath in other words, there is some data coming out from CO2 sensor
    // start to produce the acetone sensor readings
    if(millis()-acetoneRead>200){
    float V = analogRead(acetonePin)*5.0/1024.0; //mv
    float I = (V/Rshunt)/1000; // convert mA to uA 
    uint16_t AcetoneLevel = 1.667*I-0.2485; // the formula is provided on handover document
    Serial.print("Acetone Level % is now: ");
    Serial.println(AcetoneLevel); 
    acetoneRead = millis();
    
    // determine maximum acetone value
    if (AcetoneLevel<Acetoneminimum){  
        Acetoneminimum = AcetoneLevel;
      }
    if (AcetoneLevel>Acetonemaximum){
        Acetonemaximum = AcetoneLevel;
      }

    }
    
    breath_end = millis();
  }
    // for a common 5 second breath time
    if (millis()-breath_end > 5000){
      
      //if the acetone value is larger than threshold 1.8 ppm, display the user is in bad ketone level
      if (Acetonemaximum>1.8){
      display.clearDisplay();
      count=1.87;
      String vString =  String(count, 2);
      Devicetext("BAD! ", 25, 1, 2, false);
      Devicetext(vString, 25, 25, 1, false);
      Devicetext("ppm", 55, 25, 1, false);
      display.drawBitmap(90, 0,frame29,32,32, 1);
      display.display();
      delay(5000); 
      
      }
      // save the maximum acetone value if the device has external EEPROM
      if (address1 < maxaddress)
      writeEEPROM(address1, Acetonemaximum, EEPROM_I2C_ADDRESS);
      address1 += 1;
    } 

}


// determine the phone is connected to the bluetooth or not
BLEDevice central = BLE.central();
if ((central)&&(buttonState == HIGH))
{
  Serial.print("Connected to central: ");
  Serial.println(central.address());

// if phone is connected, keep publishing the stored value and new acetone reading 
while (central.connected()) {
    
    // the stored previous readings,tmep_read is standing for temporary reading
  for (int address = 0; address <= maxaddress; address++){
    // Read value from EEPROM
    temp_read = readEEPROM(address, EEPROM_I2C_ADDRESS);
    StoreChar.writeValue(temp_read);
    delay(10); 
  }
    // display the acetone readings on app
    string += ":";
    string += Acetonemaximum;
    string += ":";
    string += (unsigned long)(millis() / 100);
    char tmpl[string.length() + 1];
    string.toCharArray(tmpl, string.length() + 1);

    AcetoneLevelChar.writeValue(Acetonemaximum);
    delay(10);
  }
  

}
// 20 second buffer time, if you press the wake-up button again, will start again from heating process
digitalWrite(BUTTON, LOW);
digitalWrite(RED_PIN, LOW);
delay(20000);

Serial.print("Disconnected from central: ");
Serial.println(central.address());

}


// Function to write to EEPROOM
void writeEEPROM(int address, byte Acetonemaximum, int i2c_address)
{
  // Begin transmission to I2C EEPROM
  Wire.beginTransmission(i2c_address);
 
  // Send memory address as two 8-bit bytes
  Wire.write((int)(address >> 8));   // MSB
  Wire.write((int)(address & 0xFF)); // LSB
 
  // Send data to be stored
  Wire.write(Acetonemaximum);
 
  // End the transmission
  Wire.endTransmission();
 
  // Add 5ms delay for EEPROM
  delay(5);
}

// Function to read from EEPROM
byte readEEPROM(int address, int i2c_address)
{
  // Define byte for received data
  byte rcvData = 0xFF;
 
  // Begin transmission to I2C EEPROM
  Wire.beginTransmission(i2c_address);
 
  // Send memory address as two 8-bit bytes
  Wire.write((int)(address >> 8));   // MSB
  Wire.write((int)(address & 0xFF)); // LSB
 
  // End the transmission
  Wire.endTransmission();
 
  // Request one byte of data at current memory address
  Wire.requestFrom(i2c_address, 1);
 
  // Read the data and assign to variable
  rcvData =  Wire.read();
 
  // Return the data as function output
  return rcvData;
}

// subfuntcion for input text on OLED screen
void Devicetext(String text, int x, int y,int size, boolean d) {

  display.setTextSize(size);
  display.setTextColor(WHITE);
  display.setCursor(x,y);
  display.println(text);
  if(d){
    display.display();
  }
  
  //delay(100);
}

//subfunction for animated icons during load/processing data which is shown on video demo
void load(int T){
  int xx=48;
  int yy=0;
  int tt=0;
for (j=0; j<T; j+=1){
  
display.clearDisplay();
display.drawBitmap(xx, yy,frame0,32,32, 1);
display.display();
delay(tt);

display.clearDisplay();
display.drawBitmap(xx, yy,frame1,32,32, 1);
display.display();
delay(tt);

display.clearDisplay();
display.drawBitmap(xx, yy,frame2,32,32, 1);
display.display();
delay(tt);

display.clearDisplay();
display.drawBitmap(xx, yy,frame3,32,32, 1);
display.display();
delay(tt);

display.clearDisplay();
display.drawBitmap(xx, yy,frame4,32,32, 1);
display.display();
delay(tt);

display.clearDisplay();
display.drawBitmap(xx, yy,frame5,32,32, 1);
display.display();
delay(tt);

display.clearDisplay();
display.drawBitmap(xx, yy,frame6,32,32, 1);
display.display();
delay(tt);

display.clearDisplay();
display.drawBitmap(xx, yy,frame7,32,32, 1);
display.display();
delay(tt);

display.clearDisplay();
display.drawBitmap(xx, yy,frame8,32,32, 1);
display.display();
delay(tt);

display.clearDisplay();
display.drawBitmap(xx, yy,frame9,32,32, 1);
display.display();
delay(tt);

display.clearDisplay();
display.drawBitmap(xx, yy,frame10,32,32, 1);
display.display();
delay(tt);

display.clearDisplay();
display.drawBitmap(xx, yy,frame11,32,32, 1);
display.display();
delay(tt);

display.clearDisplay();
display.drawBitmap(xx, yy,frame12,32,32, 1);
display.display();
delay(tt);

display.clearDisplay();
display.drawBitmap(xx, yy,frame13,32,32, 1);
display.display();
delay(tt);

display.clearDisplay();
display.drawBitmap(xx, yy,frame14,32,32, 1);
display.display();
delay(tt);

display.clearDisplay();
display.drawBitmap(xx, yy,frame15,32,32, 1);
display.display();
delay(tt);

display.clearDisplay();
display.drawBitmap(xx, yy,frame16,32,32, 1);
display.display();
delay(tt);

display.clearDisplay();
display.drawBitmap(xx, yy,frame17,32,32, 1);
display.display();
delay(tt);

display.clearDisplay();
display.drawBitmap(xx, yy,frame18,32,32, 1);
display.display();
delay(tt);

display.clearDisplay();
display.drawBitmap(xx, yy,frame19,32,32, 1);
display.display();
delay(tt);

display.clearDisplay();
display.drawBitmap(xx, yy,frame20,32,32, 1);
display.display();
delay(tt);

display.clearDisplay();
display.drawBitmap(xx, yy,frame21,32,32, 1);
display.display();
delay(tt);

display.clearDisplay();
display.drawBitmap(xx, yy,frame22,32,32, 1);
display.display();
delay(tt);

display.clearDisplay();
display.drawBitmap(xx, yy,frame23,32,32, 1);
display.display();
delay(tt);

display.clearDisplay();
display.drawBitmap(xx, yy,frame24,32,32, 1);
display.display();
delay(tt);

display.clearDisplay();
display.drawBitmap(xx, yy,frame25,32,32, 1);
display.display();
delay(tt);

display.clearDisplay();
display.drawBitmap(xx, yy,frame26,32,32, 1);
display.display();
delay(tt);

display.clearDisplay();
display.drawBitmap(xx, yy,frame27,32,32, 1);
display.display();
delay(tt);


delay(1000);
} 
}

// subfunction for ready signal
void ready_sig(int T1){
  for (k=0; k<T1; k+=1){
  display.clearDisplay();
  Devicetext("READY!", 10, 10, 3, false);
  display.display();
  delay(1000); 
  }
} 