
#include <Wire.h>
#include <Adafruit_GFX.h>
#include <Adafruit_SSD1306.h>

#define SCREEN_WIDTH 128 // OLED display width, in pixels
#define SCREEN_HEIGHT 32 // OLED display height, in pixels

#define NUMFLAKES 10
#define XPOS 0
#define YPOS 1
#define DELTAY 2
#define led_pin 12

double count_T=0;
double count=1.21;
int16_t h;
int16_t i;
int16_t k;
int16_t j;
int16_t m;

// ANU Logo Bitmap
static const unsigned char PROGMEM ANU_LOGO[] = {
    0x00,0x00,0x00,0x00,0x00,0x00,0x00,0x00,0x00,0x00,0x00,0x00,0x00,0x00,0x00,0x00,
    0x00,0x00,0x00,0x00,0x00,0x00,0x00,0x00,0x00,0x00,0x00,0x00,0x00,0x00,0x00,0x00,
    0x00,0x00,0x00,0x00,0x00,0x00,0x00,0x00,0x00,0x00,0x00,0x00,0x00,0x00,0x00,0x00,
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    0x00,0x00,0x00,0x00,0x00,0x00,0x00,0x00,0x00,0x00,0x00,0x00,0x00,0x00,0x00,0x00
};

// Device Logo Bitmap
static const unsigned char PROGMEM DEVICE_LOGO[] = {
    0x00,0x00,0x00,0x00,0x00,0x00,0x00,0x00,0x00,0x00,0x00,0x00,0x00,0x00,0x00,0x00,
    0x00,0x00,0x00,0x00,0x00,0x00,0x00,0x00,0x00,0x00,0x00,0x00,0x00,0x00,0x00,0x00,
    0x00,0x01,0xFE,0x00,0x00,0x00,0x0E,0x00,0x79,0x80,0x0C,0x00,0x00,0x00,0x00,0x00,
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    0x00,0x00,0x00,0x00,0x00,0x00,0x00,0x00,0xE0,0x00,0x00,0x00,0x00,0x00,0x00,0x00

};

// Declaration for an SSD1306 display connected to I2C (SDA, SCL pins)
Adafruit_SSD1306 display(SCREEN_WIDTH, SCREEN_HEIGHT, &Wire, -1);

// Emoticons
const unsigned char PROGMEM happy_face [128] = {0x00, 0x00, 0x00, 0x00, 0x00, 0x1F, 0xF8, 0x00, 0x00, 0x7C, 0x1E, 0x00, 0x01,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 0x00, 0x00};
const unsigned char PROGMEM sad_face [128] = {0x00, 0x00, 0x00, 0x00, 0x00, 0x1F, 0xF8, 0x00, 0x00, 0x7C, 0x1E, 0x00, 0x01,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 0x00, 0x00};

// Loading animation
const unsigned char PROGMEM loading [28][128] = {{0x00, 0x00, 0x00, 0x00, 0x00, 0x00, 0x00, 0x00, 0x00, 0x00, 0x00, 0x00, 0x00,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 0x00, 0x00}, 
{0x00, 0x00, 0x00, 0x00, 0x00, 0x00, 0x00, 0x00, 0x00, 0x00, 0x00, 0x00, 0x00,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 0x00, 0x00},
{0x00, 0x00, 0x00, 0x00, 0x00, 0x00, 0x00, 0x00, 0x00, 0x00, 0x00, 0x00, 0x00,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 0x00, 0x00},
{0x00, 0x00, 0x00, 0x00, 0x00, 0x00, 0x00, 0x00, 0x00, 0x00, 0x00, 0x00, 0x00,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 0x00, 0x00},
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{0x00, 0x00, 0x00, 0x00, 0x00, 0x00, 0x00, 0x00, 0x00, 0x00, 0x00, 0x00, 0x00,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 0x00, 0x00},
};

// Display text
void Devicetext(String text, int x, int y,int size, boolean d) {
  display.setTextSize(size);
  display.setTextColor(WHITE);
  display.setCursor(x,y);
  display.println(text);
  if(d){
    display.display();
  }
}

// Loading animation function
void load(int T){
  int xx=48;
  int yy=0;
  int tt=0;
  for (j=0; j<T; j+=1){
    for (int i = 0; i < 28; i++) {
      display.clearDisplay();
      display.drawBitmap(xx, yy,loading[i],32,32, 1);
      display.display();
      delay(tt);
    }
    delay(1000);
  } 
}

// Resdy 
void ready_sig(int T1){
  display.clearDisplay();
  Devicetext("Ready!", 10, 10, 3, false);
  display.display();
  delay(T1); 
  
} 

void draw_anu(int time) {
  display.drawBitmap(0, 0, ANU_LOGO, 128, 32, 1);
  display.display();
  delay(time);
  display.clearDisplay();
}

void draw_logo(int time) {
  display.drawBitmap(0, 0, DEVICE_LOGO, 128, 32, 1);
  display.display();
  delay(time);
  display.clearDisplay();
}


void setup() {
  Serial.begin(115200);
  pinMode(led_pin,OUTPUT);
  digitalWrite(led_pin,LOW);

  if(!display.begin(SSD1306_SWITCHCAPVCC, 0x3C)) { // Address 0x3D for 128x64
    Serial.println(F("SSD1306 allocation failed"));
    for(;;);
  }
  delay(2000);
  display.clearDisplay();
  
  
}

void loop() {
  draw_anu(5000);
  draw_logo(5000);

  for(i=0; i<13; i+=1){
    String TString =  String(count_T,0);
    
    display.clearDisplay();
    Devicetext("Heating!", 20, 0, 2, false);
    Devicetext("Temp:   ", 30, 25, 1, false);
    Devicetext(TString, 65, 25, 1, false);
    Devicetext("C", 90, 25, 1, false);
    display.display();
    
    if(count_T < 349)
      count_T +=32;
    else 
      count_T = count_T-1;  
    
    delay(1000);
  }

  display.clearDisplay();
  digitalWrite(led_pin,LOW);
  ready_sig(3000);

  load(6);

  display.clearDisplay();
  Devicetext("Invaild ! ", 10, 10, 2, false);
  display.display();

  ready_sig(6);
  load(6);

  for(h=0; h<7; h+=1){
      
    String vString =  String(count, 2);
    display.clearDisplay();
    Devicetext("Acetone:        ", 20, 3, 1, false);
    Devicetext(vString, 30, 15, 2, false);
    Devicetext("ppm", 95, 20, 1, false);
    display.display();
    count +=0.11;
    delay(2000);  
  }
  delay(5000);
  display.clearDisplay();

  for(m=0; m<10; m+=1){
    
    display.clearDisplay();
    count=1.87;
    String vString =  String(count, 2);
    Devicetext("BAD! ", 25, 1, 2, false);
    Devicetext(vString, 25, 25, 1, false);
    Devicetext("ppm", 55, 25, 1, false);
    display.drawBitmap(90, 0, sad_face, 32,32, 1);
    display.display();
    delay(0);
    delay(2000);  
  }

  display.clearDisplay();
  display.display();
}
